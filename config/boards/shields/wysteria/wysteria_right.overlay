#include "wysteria.dtsi"

&default_transform { // The matrix transform for this board is 5 columns over because the left half is 5 columns wide according to the matrix.
    col-offset = <5>;
};

&kscan_0 {
    col-gpios
        = <&pro_micro 21 GPIO_ACTIVE_HIGH>
        , <&pro_micro 20 GPIO_ACTIVE_HIGH>
        , <&pro_micro 19 GPIO_ACTIVE_HIGH>
        , <&pro_micro 18 GPIO_ACTIVE_HIGH>
        , <&pro_micro 6 GPIO_ACTIVE_HIGH>
        ;
};
