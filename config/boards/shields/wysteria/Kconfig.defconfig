## config/boards/shields/wysteria/Kconfig.defconfig
```kconfig
if SHIELD_JWE_WYST

config ZMK_KEYBOARD_NAME
    default "Wysteria"

endif

if ZMK_DISPLAY

config I2C
    default y

config SSD1306
    default y

config SSD1306_REVERSE_MODE
    default y

endif # ZMK_DISPLAY
```

## config/boards/shields/wysteria/Kconfig.shield
```kconfig
config SHIELD_JWE_WYST
    def_bool $(shields_list_contains,wysteria)

config SHIELD_JWE_WYST_LEFT
    def_bool $(shields_list_contains,wysteria_left)

config SHIELD_JWE_WYST_RIGHT
    def_bool $(shields_list_contains,wysteria_right)
```
